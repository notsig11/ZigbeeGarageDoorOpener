## main/Kconfig
```kconfig
menu "Garage Door Opener"

    menu "Relay Configuration"

        config GARAGE_RELAY_COUNT
            int "Number of relay channels"
            range 1 8
            default 4
            help
                Number of relay channels (garage door buttons) supported.
                Each relay is exposed as a Zigbee Door Lock endpoint.

        config GARAGE_RELAY_PIN_1
            int "GPIO pin for relay channel 1"
            default 18
            help
                GPIO pin connected to the first relay channel.

        config GARAGE_RELAY_PIN_2
            int "GPIO pin for relay channel 2"
            default 20
            depends on GARAGE_RELAY_COUNT >= 2
            help
                GPIO pin connected to the second relay channel.

        config GARAGE_RELAY_PIN_3
            int "GPIO pin for relay channel 3"
            default 19
            depends on GARAGE_RELAY_COUNT >= 3
            help
                GPIO pin connected to the third relay channel.

        config GARAGE_RELAY_PIN_4
            int "GPIO pin for relay channel 4"
            default 21
            depends on GARAGE_RELAY_COUNT >= 4
            help
                GPIO pin connected to the fourth relay channel.

        config GARAGE_RELAY_PIN_5
            int "GPIO pin for relay channel 5"
            default 22
            depends on GARAGE_RELAY_COUNT >= 5
            help
                GPIO pin connected to the fifth relay channel.

        config GARAGE_RELAY_PIN_6
            int "GPIO pin for relay channel 6"
            default 23
            depends on GARAGE_RELAY_COUNT >= 6
            help
                GPIO pin connected to the sixth relay channel.

        config GARAGE_RELAY_PIN_7
            int "GPIO pin for relay channel 7"
            default 25
            depends on GARAGE_RELAY_COUNT >= 7
            help
                GPIO pin connected to the seventh relay channel.

        config GARAGE_RELAY_PIN_8
            int "GPIO pin for relay channel 8"
            default 26
            depends on GARAGE_RELAY_COUNT >= 8
            help
                GPIO pin connected to the eighth relay channel.

        config GARAGE_RELAY_PULSE_DURATION_MS
            int "Relay pulse duration (milliseconds)"
            range 50 2000
            default 300
            help
                Duration of the momentary pulse sent to each relay.

        config GARAGE_RELAY_ACTIVE_LEVEL
            int "Relay active logic level"
            default 0
            range 0 1
            help
                Logic level that activates the relay.
                0 = active-low, 1 = active-high.
    endmenu

    menu "Door Sensor Configuration"

        config GARAGE_DOOR_SENSOR_COUNT
            int "Number of door sensor channels"
            range 0 8
            default 1
            help
                Number of door sensor channels (magnetic reed switches).
                Each sensor reports the open/closed state via the Zigbee Door Lock cluster.
                Set to 0 to disable door sensors.

        config GARAGE_DOOR_SENSOR_PIN_1
            int "GPIO pin for door sensor channel 1"
            default 0
            depends on GARAGE_DOOR_SENSOR_COUNT >= 1
            help
                GPIO pin connected to the first door sensor (magnetic reed switch).

        config GARAGE_DOOR_SENSOR_PIN_2
            int "GPIO pin for door sensor channel 2"
            default 1
            depends on GARAGE_DOOR_SENSOR_COUNT >= 2
            help
                GPIO pin connected to the second door sensor.

        config GARAGE_DOOR_SENSOR_PIN_3
            int "GPIO pin for door sensor channel 3"
            default 2
            depends on GARAGE_DOOR_SENSOR_COUNT >= 3
            help
                GPIO pin connected to the third door sensor.

        config GARAGE_DOOR_SENSOR_PIN_4
            int "GPIO pin for door sensor channel 4"
            default 3
            depends on GARAGE_DOOR_SENSOR_COUNT >= 4
            help
                GPIO pin connected to the fourth door sensor.

        config GARAGE_DOOR_SENSOR_PIN_5
            int "GPIO pin for door sensor channel 5"
            default 4
            depends on GARAGE_DOOR_SENSOR_COUNT >= 5
            help
                GPIO pin connected to the fifth door sensor.

        config GARAGE_DOOR_SENSOR_PIN_6
            int "GPIO pin for door sensor channel 6"
            default 5
            depends on GARAGE_DOOR_SENSOR_COUNT >= 6
            help
                GPIO pin connected to the sixth door sensor.

        config GARAGE_DOOR_SENSOR_PIN_7
            int "GPIO pin for door sensor channel 7"
            default 6
            depends on GARAGE_DOOR_SENSOR_COUNT >= 7
            help
                GPIO pin connected to the seventh door sensor.

        config GARAGE_DOOR_SENSOR_PIN_8
            int "GPIO pin for door sensor channel 8"
            default 7
            depends on GARAGE_DOOR_SENSOR_COUNT >= 8
            help
                GPIO pin connected to the eighth door sensor.

        config GARAGE_DOOR_SENSOR_ACTIVE_LEVEL
            int "Door sensor active logic level"
            default 0
            range 0 1
            help
                Logic level that indicates the door is closed (reed switch closed).
                0 = active-low (reed switch pulls pin to GND when closed),
                1 = active-high (reed switch pulls pin to VCC when closed).

        config GARAGE_DOOR_SENSOR_POLL_INTERVAL_MS
            int "Door sensor poll interval (milliseconds)"
            range 1000 60000
            default 5000
            help
                How often (in milliseconds) to poll door sensors for state changes.
                This ensures the Zigbee LockState attribute reflects doors opened
                by wall buttons or remotes, not just Zigbee commands.

    endmenu

    menu "Zigbee Channel Configuration"

        config GARAGE_ZB_PRIMARY_CHANNEL_MASK
            hex "Primary channel mask"
            default 0x07FFF800
            help
                Bitmask of Zigbee channels (11-26) to scan when joining the network.
                0x07FFF800 enables all channels 11-26.
                For a single channel, use (1 << channel), e.g. (1 << 20) for channel 20.

        config GARAGE_ZB_SECONDARY_CHANNEL_MASK
            hex "Secondary channel mask"
            default 0x07FFF800
            help
                Bitmask of Zigbee channels (11-26) to scan when the primary set yields no network.
                0x07FFF800 enables all channels 11-26.
                0 means "same as primary channel mask" (never scan beyond the primary set).

    endmenu

endmenu
```
